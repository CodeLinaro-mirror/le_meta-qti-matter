## conf/layer.conf
```bitbake
BBFILES += "${LAYERDIR}/recipes/*/*.bb ${LAYERDIR}/recipes/*/*.bbappend"
BBPATH .= ":${LAYERDIR}"
BBFILE_COLLECTIONS += "qti-matter"
BBFILE_PRIORITY_qti-matter = "12"
BBFILE_PATTERN_qti-matter := "^${LAYERDIR}/"

LAYERDEPENDS_qti-matter = ""
LAYERSERIES_COMPAT_qti-matter = "dunfell kirkstone"

PREFERRED_VERSION_matter = "1.4%"
```
